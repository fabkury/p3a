"-----BEGIN CERTIFICATE-----\n"
"MIIFEzCCAvugAwIBAgIUKO8RTV3AAoxX05ClaAZEAjm02lMwDQYJKoZIhvcNAQEL\n"
"BQAwGTEXMBUGA1UEAwwOTWFrYXBpeCBEZXYgQ0EwHhcNMjUxMDI1MDIwODQ4WhcN\n"
"MjYxMDI1MDIwODQ4WjAZMRcwFQYDVQQDDA5NYWthcGl4IERldiBDQTCCAiIwDQYJ\n"
"KoZIhvcNAQEBBQADggIPADCCAgoCggIBAK8JVGxCpdp1MfgHEDCNWO2ylrDCpYp+\n"
"IoJDgTPxxrlJyZi+XsFCsxa+pjN+vJQOOLlHHLYB20zNYcWW2RvZaluskggZhBMO\n"
"U5W71ZF79U4DlyjxuAU08H28EpnK263VYxcbuKyFyTjs4M9EI7MuDpBDV5P5QAi3\n"
"Y3yaJMV/vAaf+XZgFFo3Fwfc+NmVFuH+LiYk8szqBWg5ZjIZlEql1Ue19hOtGpgp\n"
"lDhU5Ul01oDGeUykIFqqwm5RMHwxwmCuCvjNW+DWPT5kRy+JbhiugnxyhYSQbTYb\n"
"ZzzhC0NGYBFJGriECgAHMF6TvROUuMaX4wEQnByTLyDz6lFUrreAPZgiGjwmRjHA\n"
"59Owb4DD/KF9DRt1pkQvr6yL6qML/AiC5E7qGO6gcn7Lu7KT+H3L7AapnT60qh7Z\n"
"ubLU7kaGytzCMCwlptY93Buc3olbitGvpVKegNIVCOg52UVn6KuWZKYln9QOBVWR\n"
"Dwsc6QJVd/webostPJOGG1ViLJgteNivYpNdvWBbtPdrPKpKcwc8nBiIN22AVC6k\n"
"k/5I79Y8vHTO+entxoRzz5c5bIB1+X27ZsQBkdvSQVScdUUEpjWqPAWlaz2s8gJ8\n"
"PJ6QaJtLcn7uTuSQAL84IuZ7viFGISt+9dUKOWeUwZdRq0BPHdeyofo3OyxJyAZt\n"
"wX5iAGNLhuXLAgMBAAGjUzBRMB0GA1UdDgQWBBS5EOMlvSik5+APN1GnwcHAkr1L\n"
"mzAfBgNVHSMEGDAWgBS5EOMlvSik5+APN1GnwcHAkr1LmzAPBgNVHRMBAf8EBTAD\n"
"AQH/MA0GCSqGSIb3DQEBCwUAA4ICAQAsrf4+RMM1hUzsF0QxnE4CTMdBGQ+P57nZ\n"
"BZDAXVG3b6VSccvA/p2e7y0qKxb/IMoJEk+mkwrzTCRrvsP9z+ss9VPLK9u3N761\n"
"NJkY62TjVyNcb2zY6gR6VkQ8LJ1Ephc09AVp5z7D2Gr/DKOR2rhkyWJxh0kx/YM9\n"
"uKDqDyurQ+KwOLhD6bHC23MkDMeKwEMpYFtKubb9dRWXcGJXIddBrC+c7R9D4tm8\n"
"xb8uDLhyQjR0jmke4ufjRdbpKDmo/zlvZnFJ8PmsOUcfGl19GzkcU5PV+TnvsQ4g\n"
"uq9GKeNngOWueTy8V3Lks/fMKMvQH7zQutaBdA1ujJu2zmLqg9MENnDwSb9VYhdI\n"
"f0/eg4R+CvaxCiZ5oTbGRcEJI3c42WziYOe9e9I18Le5NOBe+kWC1py8jhGsx6dc\n"
"h3m1MOJaO7217RXhh5a8U0nknjNPHdtuGgHFSwOkK0v70fve+RLw2KZXYpza+O+c\n"
"nTpmub9mugldbJwfurunkpx5MhADUTCxpkbTs/xbnLGvf7YfTityQSgC/7C0Hs/q\n"
"VBdRGQnk8omJbDyARgV0pR+nA3LOWkIo8Cyb9bbmqFly7Fxw0RjnZkNrAnimH+Tt\n"
"7/g9om3JLrW5ox8yr+u+h3cOB5fmUkQoO5G2k93m4Ydscv7HqYz3Gv3BU9M3ZP+F\n"
"LUem4dM3dg==\n"
"-----END CERTIFICATE-----\n"
