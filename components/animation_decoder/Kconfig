## components/storage_eviction/Kconfig
```kconfig
menu "Storage Eviction"

    config STORAGE_EVICTION_TARGET_PCT
        int "Free space trigger threshold in % of card capacity"
        range 1 50
        default 10
        help
            Low watermark for the SD card free space, as a percentage
            of the card's total formatted capacity. When free space
            falls below this threshold, an eviction pass starts and
            keeps deleting until free space reaches the high watermark
            (trigger + headroom). See STORAGE_EVICTION_HEADROOM_PCT.

            The computed value is clamped to a floor of 256 MiB and a
            ceiling of STORAGE_EVICTION_TARGET_MIB, so the watermarks
            scale down for small cards while large cards keep the
            classic fixed-watermark behavior.

    config STORAGE_EVICTION_TARGET_MIB
        int "Trigger threshold ceiling in MiB"
        default 1024
        help
            Upper bound for the capacity-derived trigger watermark.
            Whenever STORAGE_EVICTION_TARGET_PCT of the card's capacity
            exceeds this value, this value is used instead. With the
            defaults (10% capped at 1024 MiB) the ceiling binds from
            ~10 GiB of formatted capacity upward — in practice, cards
            advertised as 16 GB and larger.

    config STORAGE_EVICTION_HEADROOM_PCT
        int "Free space headroom in % of card capacity"
        range 1 90
        default 25
        help
            Hysteresis between the trigger threshold and the stop
            condition, as a percentage of the card's total formatted
            capacity. Once eviction starts (free < trigger), it keeps
            running until free >= trigger + headroom. A larger headroom
            means fewer eviction passes but each pass deletes more
            files.

            The computed value is clamped to a floor of 512 MiB and a
            ceiling of STORAGE_EVICTION_HEADROOM_MIB.

    config STORAGE_EVICTION_HEADROOM_MIB
        int "Headroom ceiling in MiB"
        default 4096
        help
            Upper bound for the capacity-derived headroom. Whenever
            STORAGE_EVICTION_HEADROOM_PCT of the card's capacity
            exceeds this value, this value is used instead. With the
            defaults (25% capped at 4096 MiB) the ceiling binds from
            16 GiB of formatted capacity upward — cards advertised as
            32 GB and larger reproduce the classic "keep ~5 GiB free"
            behavior.

    config STORAGE_EVICTION_MIN_CARD_SIZE_MIB
        int "Minimum SD card total size in MiB to enable eviction"
        default 1024
        help
            Eviction is skipped entirely on SD cards whose total
            capacity is smaller than this threshold. Because the
            watermarks scale with capacity, eviction is viable on any
            card comfortably larger than the watermark floors
            (256 + 512 MiB combined); below this threshold the stop
            watermark would eat most of the card, so the device just
            fills the card with downloads and then stops accepting new
            ones rather than churn the file system. Set to 0 to
            disable the guard entirely.

    config STORAGE_EVICTION_INITIAL_AGE_DAYS
        int "Initial age threshold in days"
        default 30
        help
            First eviction pass deletes files not accessed within
            this many days. If more space is needed, the threshold
            is halved on each subsequent pass.

    config STORAGE_EVICTION_MIN_AGE_HOURS
        int "Minimum age threshold in hours"
        default 4
        help
            Floor for the age threshold. Files accessed more recently
            than this are never deleted, even if the free space target
            has not been reached.

    config CHANNEL_EVICTION_AGE_DAYS
        int "Channel cache eviction age in days"
        default 60
        help
            Channel cache files (.cache, .json, .settings.json) that
            have not been loaded for playback within this many days
            are deleted. Channels in the active playset are always
            protected regardless of age.

endmenu
```

## components/wifi_manager/Kconfig
```kconfig
menu "WiFi Manager"

    config WIFI_MANAGER_ENABLED
        bool "Enable WiFi Manager"
        default y
        help
            Enable WiFi station with captive portal support.

    config WIFI_MANAGER_SNTP_SERVER
        string "SNTP server address"
        default "pool.ntp.org"
        depends on WIFI_MANAGER_ENABLED
        help
            NTP server for time synchronization.

endmenu
```

## def/sdkconfig.defaults.esp32p4
```kconfig
CONFIG_IDF_TARGET="esp32p4"
CONFIG_BSP_BOARD_TYPE_FIB=y
CONFIG_BSP_LCD_CONTROLLER_EK79007=y
CONFIG_COMPILER_ORPHAN_SECTIONS_PLACE=y
CONFIG_ESP32P4_REV_MIN_1=y
CONFIG_SPIRAM=y
CONFIG_SPIRAM_SPEED_200M=y
CONFIG_FREERTOS_HZ=1000
CONFIG_IDF_EXPERIMENTAL_FEATURES=y
CONFIG_COMPILER_OPTIMIZATION_PERF=y
CONFIG_CACHE_L2_CACHE_256KB=y
CONFIG_CACHE_L2_CACHE_LINE_128B=y
CONFIG_BSP_LCD_DPI_BUFFER_NUMS=2
CONFIG_BSP_LCD_COLOR_FORMAT_RGB888=y
# CONFIG_BSP_LCD_COLOR_FORMAT_RGB565 is not set
CONFIG_LCD_PIXEL_FORMAT_RGB888=y
# CONFIG_LCD_PIXEL_FORMAT_RGB565 is not set
CONFIG_P3A_MAX_SPEED_PLAYBACK=n
# Touch gesture configuration defaults
CONFIG_P3A_TOUCH_SWIPE_MIN_HEIGHT_PERCENT=10
CONFIG_P3A_TOUCH_BRIGHTNESS_MAX_DELTA_PERCENT=75
# Wi-Fi configuration
CONFIG_ESP_WIFI_STATIC_RX_BUFFER_NUM=10
CONFIG_ESP_WIFI_DYNAMIC_RX_BUFFER_NUM=32
CONFIG_ESP_WIFI_DYNAMIC_TX_BUFFER_NUM=32
CONFIG_ESP_WIFI_TX_BUFFER_TYPE=1
CONFIG_ESP_WIFI_DYNAMIC_RX_MGMT_BUF=0
CONFIG_ESP_WIFI_ESPNOW_MAX_ENCRYPT_NUM=7
# ESP-Hosted configuration (for ESP32-P4 remote Wi-Fi via ESP32-C6)
CONFIG_ESP_HOSTED_ENABLED=y
CONFIG_ESP_HOSTED_SDIO_HOST_INTERFACE=y
CONFIG_ESP_HOSTED_IDF_SLAVE_TARGET="esp32c6"
CONFIG_ESP_HOSTED_P4_DEV_BOARD_NONE=y
CONFIG_ESP_HOSTED_PRIV_SDIO_OPTION=y
CONFIG_ESP_HOSTED_SDIO_RESET_ACTIVE_HIGH=y
CONFIG_ESP_HOSTED_SDIO_OPTIMIZATION_RX_STREAMING_MODE=y
CONFIG_ESP_HOSTED_SDIO_SLOT_1=y
CONFIG_ESP_HOSTED_SDIO_SLOT=1
CONFIG_ESP_HOSTED_SDIO_4_BIT_BUS=y
CONFIG_ESP_HOSTED_SDIO_BUS_WIDTH=4
CONFIG_ESP_HOSTED_SDIO_CLOCK_FREQ_KHZ=40000
CONFIG_ESP_HOSTED_SDIO_GPIO_RESET_SLAVE=54
CONFIG_ESP_HOSTED_SDIO_PIN_CMD=19
CONFIG_ESP_HOSTED_SDIO_PIN_CLK=18
CONFIG_ESP_HOSTED_SDIO_PIN_D0=14
CONFIG_ESP_HOSTED_SDIO_PIN_D1=15
CONFIG_ESP_HOSTED_SDIO_PIN_D2=16
CONFIG_ESP_HOSTED_SDIO_PIN_D3=17
CONFIG_ESP_HOSTED_SDIO_TX_Q_SIZE=20
CONFIG_ESP_HOSTED_SDIO_RX_Q_SIZE=20
CONFIG_ESP_HOSTED_SDIO_RESET_DELAY_MS=1500
CONFIG_ESP_HOSTED_SLAVE_RESET_ON_EVERY_HOST_BOOTUP=y
CONFIG_ESP_HOSTED_GPIO_SLAVE_RESET_SLAVE=54
CONFIG_ESP_WIFI_REMOTE_ENABLED=y
CONFIG_ESP_WIFI_REMOTE_LIBRARY_HOSTED=y
CONFIG_HTTPD_WS_SUPPORT=y
```

## main/Kconfig.projbuild
```kconfig
menu "Physical Player of Pixel Art (P3A)"

    menu "General"
        config P3A_AUTO_SWAP_INTERVAL_SECONDS
            int "Auto-swap interval (seconds)"
            default 30
            range 5 300
            help
                Number of seconds of inactivity before automatically cycling to the next animation.
                Set to 0 to disable auto-swap entirely.

        config P3A_STATIC_FRAME_DELAY_MS
            int "Static image frame delay (ms)"
            default 100
            range 10 1000
            help
                Frame delay used for static images (PNG, JPEG) when played as animations.
                This simulates animation timing for single-frame images.
    endmenu

    menu "Display"
        config P3A_LCD_ENABLE_CACHE_FLUSH
            bool "Flush LCD frame buffer via esp_cache_msync"
            default y
            help
                Enable cache flushes before handing the framebuffer to the panel driver.
                Disable to evaluate DMA coherency without the extra msync cost.
    endmenu

    menu "Animation"
        config P3A_SD_ANIMATIONS_DIR
            string "SD card animations directory"
            default "/sdcard/animations"
            help
                Directory path on SD card containing WebP animation files.
                Files will be loaded alphabetically.

        config P3A_MAX_SPEED_PLAYBACK
            bool "Ignore WebP frame delays and play at maximum speed"
            default y
            help
                When enabled, the animation task disregards per-frame timing metadata and
                schedules the next frame as soon as it is ready. Disable to respect the
                original WebP delays.

        config P3A_RENDER_TASK_PRIORITY
            int "Animation task priority"
            default 5
            range 1 15
            help
                FreeRTOS priority assigned to the animation render task.
    endmenu

    menu "Touch"
        config P3A_TOUCH_TASK_PRIORITY
            int "Touch task priority"
            default 5
            range 1 15
            help
                FreeRTOS priority assigned to the touch controller polling task.

        config P3A_TOUCH_POLL_INTERVAL_MS
            int "Touch poll interval (ms)"
            default 20
            range 5 100
            help
                Delay between successive reads of the touch controller.

        config P3A_TOUCH_SWIPE_MIN_HEIGHT_PERCENT
            int "Minimum swipe height percentage"
            default 10
            range 5 50
            help
                Minimum vertical swipe distance (as percentage of screen height) required
                to trigger brightness control gesture. Smaller values make gestures more sensitive.

        config P3A_TOUCH_BRIGHTNESS_MAX_DELTA_PERCENT
            int "Maximum brightness change per full swipe"
            default 75
            range 10 100
            help
                Maximum brightness change (in percentage points) when performing a full
                vertical swipe from one edge to the opposite edge of the screen.
    endmenu

    menu "Wi-Fi"
        config ESP_WIFI_SSID
            string "WiFi SSID"
            default "myssid"
            help
                SSID (network name) for the device to connect to.

        config ESP_WIFI_PASSWORD
            string "WiFi Password"
            default "mypassword"
            help
                WiFi password (WPA or WPA2) for the device to use.

        choice ESP_WIFI_SAE_MODE
            prompt "WPA3 SAE mode selection"
            default ESP_WPA3_SAE_PWE_BOTH
            help
                Select mode for SAE as Hunt and Peck, H2E or both.
            config ESP_WPA3_SAE_PWE_HUNT_AND_PECK
                bool "HUNT AND PECK"
            config ESP_WPA3_SAE_PWE_HASH_TO_ELEMENT
                bool "H2E"
            config ESP_WPA3_SAE_PWE_BOTH
                bool "BOTH"
        endchoice

        config ESP_WIFI_PW_ID
            string "PASSWORD IDENTIFIER"
            depends on ESP_WPA3_SAE_PWE_HASH_TO_ELEMENT || ESP_WPA3_SAE_PWE_BOTH
            default ""
            help
                password identifier for SAE H2E

        config ESP_MAXIMUM_RETRY
            int "Maximum retry"
            default 3
            help
                Set the Maximum retry to avoid station reconnecting to the AP unlimited when the AP is really inexistent.
                After this many failures, the device will start the captive portal.

        config ESP_AP_SSID
            string "Soft AP SSID"
            default "p3a-setup"
            help
                SSID (network name) for the Soft AP when captive portal is active.

        config ESP_AP_PASSWORD
            string "Soft AP Password"
            default ""
            help
                Password for the Soft AP. Leave empty for open network.

        choice ESP_WIFI_SCAN_AUTH_MODE_THRESHOLD
            prompt "WiFi Scan auth mode threshold"
            default ESP_WIFI_AUTH_WPA2_PSK
            help
                The weakest authmode to accept in the scan mode.
                This value defaults to ESP_WIFI_AUTH_WPA2_PSK incase password is present and ESP_WIFI_AUTH_OPEN is used.
                Please select ESP_WIFI_AUTH_WEP/ESP_WIFI_AUTH_WPA_PSK incase AP is operating in WEP/WPA mode.

            config ESP_WIFI_AUTH_OPEN
                bool "OPEN"
            config ESP_WIFI_AUTH_WEP
                bool "WEP"
            config ESP_WIFI_AUTH_WPA_PSK
                bool "WPA PSK"
            config ESP_WIFI_AUTH_WPA2_PSK
                bool "WPA2 PSK"
            config ESP_WIFI_AUTH_WPA_WPA2_PSK
                bool "WPA/WPA2 PSK"
            config ESP_WIFI_AUTH_WPA3_PSK
                bool "WPA3 PSK"
            config ESP_WIFI_AUTH_WPA2_WPA3_PSK
                bool "WPA2/WPA3 PSK"
            config ESP_WIFI_AUTH_WAPI_PSK
                bool "WAPI PSK"
        endchoice
    endmenu

    choice
        prompt "LCD color format"
        default LCD_PIXEL_FORMAT_RGB888
        help
            Select the framebuffer color encoding used by the panel driver.

        config LCD_PIXEL_FORMAT_RGB565
            bool "RGB565"
            select BSP_LCD_COLOR_FORMAT_RGB565

        config LCD_PIXEL_FORMAT_RGB888
            bool "RGB888"
            depends on IDF_TARGET_ESP32P4
            select BSP_LCD_COLOR_FORMAT_RGB888
    endchoice

    menu "USB"
        config P3A_PICO8_USB_STREAM_ENABLE
            bool "Enable USB composite + PICO-8 streaming"
            default y
            help
                Enable the TinyUSB composite device that exposes CDC, MSC and a
                vendor-specific streaming interface for the PICO-8 monitor mode.
                Disable to build firmware without the USB composite stack.
    endmenu
endmenu
```

## sdkconfig.defaults
```kconfig
CONFIG_IDF_TARGET="esp32p4"
CONFIG_ESP_WIFI_REMOTE_ENABLED=y
CONFIG_ESP_WIFI_REMOTE_IDF_SPECIFIC_ADDED=y
CONFIG_SLAVE_IDF_TARGET_ESP32C6=y
CONFIG_SLAVE_IDF_TARGET_ARCH_RISCV=y
CONFIG_SLAVE_SOC_WIFI_SUPPORTED=y
CONFIG_SLAVE_SOC_WIFI_HW_TSF=y
CONFIG_SLAVE_SOC_WIFI_FTM_SUPPORT=y
CONFIG_SLAVE_SOC_WIFI_GCMP_SUPPORT=y
CONFIG_SLAVE_SOC_WIFI_HE_SUPPORT=y
CONFIG_SLAVE_SOC_WIFI_MAC_VERSION_NUM=2
CONFIG_SLAVE_FREERTOS_UNICORE=y
CONFIG_WIFI_RMT_SOFTAP_SUPPORT=y
CONFIG_IDF_EXPERIMENTAL_FEATURES=y
CONFIG_PARTITION_TABLE_CUSTOM=y
CONFIG_PARTITION_TABLE_FILENAME="partitions.csv"
CONFIG_COMPILER_OPTIMIZATION_SIZE=y
CONFIG_ESPTOOLPY_FLASHSIZE_32MB=y
CONFIG_ESPTOOLPY_FLASHSIZE="32MB"
CONFIG_SPIRAM=y
CONFIG_SPIRAM_SPEED_80M=y
# CONFIG_SPIRAM_SPEED_20M is not set
CONFIG_SPIRAM_USE_MALLOC=y
CONFIG_SPIRAM_BOOT_INIT=y
# Increase main task stack size for LVGL demo widgets and FATFS LFN support
CONFIG_ESP_MAIN_TASK_STACK_SIZE=16384
CONFIG_LV_MEM_SIZE_KILOBYTES=64
CONFIG_LV_FONT_MONTSERRAT_16=y
CONFIG_LV_FONT_MONTSERRAT_24=y
CONFIG_LV_USE_OBSERVER=y
CONFIG_LV_USE_SYSMON=y
CONFIG_LV_USE_PERF_MONITOR=y
CONFIG_LV_PERF_MONITOR_ALIGN_TOP_RIGHT=y
CONFIG_LV_USE_DEMO_WIDGETS=y
CONFIG_PARTITION_TABLE_FILENAME="partitions.csv"
CONFIG_SPIFFS_MAX_PARTITIONS=3
CONFIG_BSP_LCD_COLOR_FORMAT_RGB888=y
# CONFIG_BSP_LCD_COLOR_FORMAT_RGB565 is not set
CONFIG_BSP_LCD_DPI_BUFFER_NUMS=1
CONFIG_LV_COLOR_DEPTH_24=y
# CONFIG_LV_COLOR_DEPTH_16 is not set
CONFIG_LV_COLOR_DEPTH=24

# Enable frame pointer for better crash backtraces
CONFIG_ESP_SYSTEM_USE_FRAME_POINTER=y

# Enable comprehensive heap poisoning for memory corruption detection
CONFIG_HEAP_POISONING_COMPREHENSIVE=y
```
