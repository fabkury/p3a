## components/animation_decoder/Kconfig
```kconfig
menu "Animation Decoder"

    config ANIMATION_DECODER_STATIC_FRAME_DELAY_MS
        int "Static image frame delay (ms)"
        default 100
        range 10 1000
        help
            Frame delay used for static images (PNG, JPEG) when played as animations.
            This controls how long a static image is displayed before the decoder
            indicates it's ready to "advance" to the next frame (which is the same image).

endmenu
```

## components/bsp_extra/Kconfig
```kconfig
menu "Board Support Package"
    # BSP_I2S_NUM is defined by the Waveshare ESP32-P4 board component
    # No need to redefine it here
endmenu
```

## components/channel_manager/Kconfig
```kconfig
menu "Channel Manager"

    config CHANNEL_MANAGER_PAGE_SIZE
        int "Query page size"
        default 32
        range 8 64
        help
            Number of posts returned per paginated query.

endmenu
```

## components/giphy/Kconfig
```kconfig
menu "Giphy Integration"

    config GIPHY_API_KEY_DEFAULT
        string "Default Giphy API Key"
        default ""
        help
            Giphy API key. No built-in default is provided; the user must
            configure a key via the web UI (stored in NVS).

    config GIPHY_RENDITION_DEFAULT
        string "Default rendition"
        default "fixed_height"
        help
            Default Giphy rendition to download.
            Options: fixed_height, fixed_width, original, downsized_medium, downsized

    config GIPHY_FORMAT_DEFAULT
        string "Default format"
        default "gif"
        help
            Default file format to download.
            Options: webp, gif

endmenu
```

## components/http_fetch/Kconfig
```kconfig
menu "HTTP Fetch"

    config HTTP_FETCH_MAX_CONCURRENT_TLS
        int "Max concurrent TLS sessions through http_fetch"
        range 1 8
        default 2
        help
            Upper bound on how many HTTP(S) transfers issued through the shared
            http_fetch helper may hold a live TLS session at the same time. A
            counting semaphore in do_fetch() blocks the (N+1)-th concurrent fetch
            until an in-flight one releases its slot.

            This caps the concurrent-TLS contention on the single Wi-Fi link that
            starves large downloads: a socket read stalls past its timeout, lwIP
            returns EAGAIN (logged as "esp_tls_conn_read error, errno=No more
            processes"), esp_http_client reports it as end-of-stream, and the
            transfer is retried as a truncated read. Big GIFs could lose every
            retry. See docs/concurrent-tls-eagain-tabled.md (Option 4).

            2 preserves the Giphy API-page-fetch + binary-download overlap that
            cold-start latency depends on, while blocking a third session from
            piling on during a refresh burst. Set to 1 to fully serialize all
            http_fetch transfers if 2 still shows contention.

            Note: this gates only transfers that go through http_fetch. The
            persistent Makapix MQTT-over-TLS link runs on a separate stack and is
            not gated (it benefits indirectly from the reduced HTTP contention).

endmenu
```

## components/klipy/Kconfig
```kconfig
menu "Klipy Integration"

    config KLIPY_API_KEY_DEFAULT
        string "Default Klipy API Key"
        default ""
        help
            Klipy API key. No built-in default is provided; the user must
            configure a key via the web UI (stored in NVS). Get a free key at
            partner.klipy.com.

    config KLIPY_FORMAT_DEFAULT
        string "Default format"
        default "gif"
        help
            Default file format to download. At equal pixel size GIF is
            preferred over WebP; set to "webp" for a smaller download footprint.
            Options: gif, webp

    config KLIPY_RATING_DEFAULT
        string "Default content rating"
        default "pg-13"
        help
            Default Klipy content rating filter. Options: g, pg, pg-13, r

endmenu
```

## components/makapix/Kconfig
```kconfig
menu "Makapix Configuration"

    config MAKAPIX_CLUB_HOST
        string "Makapix Club Host"
        default "makapix.club"
        help
            Hostname of the Makapix Club server for provisioning and API calls.

    config MAKAPIX_VAULT_HOST
        string "Makapix Club Vault Host"
        default "vault.makapix.club"
        help
            Hostname serving Makapix Club artwork files, as
            https://{vault_host}/{shard}/{storage_key}.{ext}. Faster than the
            deprecated https://{club_host}/api/vault/... form it replaces.

    config MAKAPIX_CLUB_MQTT_PORT
        int "Makapix Club MQTT Port"
        default 8883
        range 1 65535
        help
            Port number for the Makapix Club MQTT broker.
            Default is 8883 for TLS/mTLS connections.

    config MAKAPIX_CERT_RENEW_WINDOW_DAYS
        int "Certificate renewal window (days before expiry)"
        default 45
        range 1 3650
        help
            The device starts trying to renew its MQTT client certificate
            once it is within this many days of the certificate's notAfter.
            Must not exceed the server's CERT_RENEWAL_THRESHOLD_DAYS (90 in
            production) or the server rejects the attempts with HTTP 400
            until the server-side window opens. Values above 90 are for
            end-to-end testing against a dev server whose threshold has been
            raised to match (e.g. 3650 makes a fresh 3-year cert immediately
            renewable on both sides).

    config MAKAPIX_CERT_RENEW_CHECK_HOURS
        int "Certificate renewal check interval (hours)"
        default 24
        range 1 168
        help
            How often the renewal task re-evaluates the stored client
            certificate's remaining lifetime.

endmenu
```

## components/ota_manager/Kconfig
```kconfig
menu "OTA Manager Configuration"

config OTA_WEBUI_ENABLE
    bool "Enable Web UI OTA updates"
    default y
    help
        Enable automatic over-the-air updates for the web UI partition.
        When enabled, the device will check for web UI updates alongside
        firmware updates and install them automatically.

        The web UI version is independent of the firmware version.
        Updates are downloaded from GitHub Releases (storage.bin) and
        written directly to the LittleFS partition.

config OTA_DEV_MODE
    bool "Enable OTA development mode"
    default n
    help
        When enabled, the device will also check for and install pre-release
        versions from GitHub. This is useful for testing OTA updates before
        publishing them to all users.

        Testing workflow:
        1. Enable this option during development
        2. Create pre-releases on GitHub for testing
        3. Test the OTA flow thoroughly
        4. Disable this option for production builds
        5. Create regular releases for all users

config OTA_CHECK_INTERVAL_HOURS
    int "Update check interval (hours)"
    default 12
    range 1 24
    help
        How often to automatically check for firmware updates.
        Default is 12 hours.

config OTA_GITHUB_REPO
    string "GitHub repository (owner/repo)"
    default "fabkury/p3a"
    help
        GitHub repository for firmware releases in format "owner/repo".

config OTA_FIRMWARE_ASSET_NAME
    string "Firmware asset filename"
    default "p3a.bin"
    help
        Name of the firmware binary file in GitHub releases.

config OTA_DOWNLOAD_TIMEOUT_SEC
    int "Download timeout (seconds)"
    default 600
    range 60 1800
    help
        Maximum time allowed for firmware download.

config OTA_HTTP_BUFFER_SIZE
    int "HTTP receive buffer size"
    default 4096
    range 1024 16384
    help
        Buffer size for HTTP client during OTA download.

endmenu
```

## components/p3a_board_ep44b/Kconfig
```kconfig
menu "P3A Board Configuration (EP44B)"

    config P3A_BOARD_EP44B
        bool
        default y
        help
            This board is the Waveshare ESP32-P4-WIFI6-Touch-LCD-4B.
            720x720 pixel display with MIPI-DSI interface.

    choice P3A_PIXEL_FORMAT
        prompt "Display pixel format"
        default P3A_PIXEL_FORMAT_RGB888

        config P3A_PIXEL_FORMAT_RGB888
            bool "RGB888 (24-bit)"
            select BSP_LCD_COLOR_FORMAT_RGB888
            
        config P3A_PIXEL_FORMAT_RGB565
            bool "RGB565 (16-bit)"
            select BSP_LCD_COLOR_FORMAT_RGB565
    endchoice

    config P3A_DISPLAY_BUFFER_COUNT
        int "Number of display buffers"
        default 2
        range 1 3
        help
            Number of framebuffers for display. 2 enables double-buffering.

    # ============ BOARD CAPABILITIES ============
    # These define what hardware features are available

    config P3A_HAS_TOUCH
        bool "Board has touch screen"
        default y
        help
            EP44B has a GT911 capacitive touch controller.

    config P3A_HAS_BRIGHTNESS_CONTROL
        bool "Board has brightness control"
        default y
        help
            EP44B supports PWM backlight brightness control.

    config P3A_HAS_WIFI
        bool "Board has WiFi"
        default y
        help
            EP44B has WiFi via ESP32-C6 coprocessor.

    config P3A_HAS_USB
        bool "Board has USB port"
        default y
        help
            EP44B has USB-C port for mass storage and PICO-8 streaming.

    config P3A_HAS_SDCARD
        bool "Board has SD card slot"
        default y
        help
            EP44B has microSD card slot for animation storage.

    config P3A_HAS_BUTTONS
        bool "Board has physical buttons"
        default n
        help
            EP44B does not have physical buttons.

endmenu
```

## components/pico8/Kconfig
```kconfig
menu "P3A Features"

menu "PICO-8 Streaming"

    config P3A_PICO8_ENABLE
        bool "Enable PICO-8 streaming support"
        default y
        help
            Enable PICO-8 pixel art streaming over USB/WebSocket.
            When disabled, PICO-8 streaming functions are stubbed out.

    if P3A_PICO8_ENABLE

        config P3A_PICO8_MODE_TIMEOUT_MS
            int "PICO-8 mode timeout (ms)"
            default 30000
            range 5000 120000
            help
                Time in milliseconds after which PICO-8 mode will automatically
                exit if no frames are received. This prevents the display from
                being stuck in PICO-8 mode if the connection is lost.

        config P3A_PICO8_USB_STREAM_ENABLE
            bool "Enable USB PICO-8 streaming interface"
            default y
            depends on P3A_USB_MSC_ENABLE
            help
                Add vendor-specific USB interface for PICO-8 frame streaming.
                Requires USB MSC to be enabled.

        config P3A_PICO8_AUDIO_ENABLE
            bool "Enable PICO-8 audio streaming"
            default y
            help
                Enable streaming PICO-8 game audio to the on-board speaker.
                Requires the ES8311 audio codec and NS4150B amplifier.

        if P3A_PICO8_AUDIO_ENABLE

            config P3A_PICO8_AUDIO_VOLUME
                int "Default PICO-8 audio volume (0-100)"
                default 60
                range 0 100
                help
                    Default hardware volume for PICO-8 audio playback.
                    Acts as a master ceiling; the browser applies per-session
                    volume scaling on top.

            config P3A_PICO8_AUDIO_BUFFER_SIZE
                int "Audio ring buffer size (bytes)"
                default 4096
                range 2048 16384
                help
                    Size of the ring buffer for audio sample delivery.
                    Larger values absorb more jitter but add latency.

        endif # P3A_PICO8_AUDIO_ENABLE

    endif # P3A_PICO8_ENABLE

endmenu # PICO-8 Streaming

endmenu # P3A Features
```

## components/play_scheduler/Kconfig
```kconfig
menu "Play Scheduler"

    config PLAY_SCHEDULER_HISTORY_SIZE
        int "History buffer size"
        default 32
        range 8 128
        help
            Number of previously played artworks to keep in history.
            Allows navigation back through recently played items.

    config PLAY_SCHEDULER_MAX_CHANNELS
        int "Maximum channels"
        default 64
        range 1 64
        help
            Maximum number of channels that can be active simultaneously.

endmenu
```

## components/slave_ota/Kconfig
```kconfig
menu "Slave OTA"

config P3A_SLAVE_OTA_MOCK
    bool "Mock slave OTA (test screen ownership without real OTA)"
    default n
    help
      When enabled, slave_ota_check_and_update runs through all the UX
      paths (UI ownership, input lockout, success countdown, reboot)
      but does NOT call esp_hosted_slave_ota_*. Used to verify the
      screen-owning code without burning real OTA cycles. Disable
      before shipping.

config P3A_SLAVE_OTA_MOCK_DURATION_MS
    int "Total mock duration (ms)"
    depends on P3A_SLAVE_OTA_MOCK
    default 10000
    range 2000 60000
    help
      How long the mock OTA takes to climb from 0% to 100%, in
      milliseconds. Defaults to 10 seconds, similar to a real ~1 MB
      transfer over SDIO. Bump this when manually testing the input
      lockout to give yourself a wider window to press buttons or
      issue commands.

endmenu
```
